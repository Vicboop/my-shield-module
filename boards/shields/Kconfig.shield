## boards/shields/Kconfig.shield
```kconfig
config SHIELD_KEYBOARDV3_LEFT
    def_bool $(shields_list_contains,keyboardv3_left)

config SHIELD_KEYBOARDV3_RIGHT
    def_bool $(shields_list_contains,keyboardv3_right)
```

## boards/shields/keyboardv3/Kconfig.defconfig
```kconfig
if SHIELD_KEYBOARDV3_LEFT

config ZMK_KEYBOARD_NAME
    default "Keyboardv3"

config ZMK_SPLIT
    default y

config ZMK_SPLIT_ROLE_CENTRAL
    default y

endif

if SHIELD_KEYBOARDV3_RIGHT

config ZMK_SPLIT
    default y

endif
```

## boards/shields/keyboardv3/Kconfig.shield
```kconfig
config SHIELD_KEYBOARDV3_LEFT
    def_bool $(shields_list_contains,keyboardv3_left)

config SHIELD_KEYBOARDV3_RIGHT
    def_bool $(shields_list_contains,keyboardv3_right)

config SHIELD_KEYBOARDV3
    def_bool SHIELD_KEYBOARDV3_LEFT || SHIELD_KEYBOARDV3_RIGHT
```
